## layers/meta-toynas-genericx86/conf/layer.conf
```bitbake
BBPATH .= ":${LAYERDIR}"

BBFILES += "${LAYERDIR}/recipes-*/*/*.bb \
            ${LAYERDIR}/recipes-*/*/*.bbappend"

BBFILE_COLLECTIONS += "toynas-genericx86"
BBFILE_PATTERN_toynas-genericx86 := "^${LAYERDIR}/"
BBFILE_PRIORITY_toynas-genericx86 = "1337"

LAYERSERIES_COMPAT_toynas-genericx86 = "dunfell"

PREFERRED_VERSION_linux-yocto ?= "5.8.18"
```

## layers/meta-toynas/meta-toynas-common/conf/layer.conf
```bitbake
BBPATH .= ":${LAYERDIR}"

BBFILES += "${LAYERDIR}/recipes-*/*/*.bb \
            ${LAYERDIR}/recipes-*/*/*.bbappend"

BBFILE_COLLECTIONS += "toynas-common"
BBFILE_PATTERN_toynas-common := "^${LAYERDIR}/"
BBFILE_PRIORITY_toynas-common = "1337"

LAYERSERIES_COMPAT_toynas-common = "dunfell"

BALENA_DEPRECATED_YOCTO_LAYER ?= "0"

RESIN_COREBASE := '${@os.path.normpath("${LAYERDIR}/")}'

IMAGE_ROOTFS_SIZE ?= "0"
```

## layers/meta-toynas/meta-toynas-dunfell/conf/layer.conf
```bitbake
BBPATH .= ":${LAYERDIR}"

BBFILES += "${LAYERDIR}/recipes-*/*/*.bb \
            ${LAYERDIR}/recipes-*/*/*.bbappend"

BBFILE_COLLECTIONS += "toynas-dunfell"
BBFILE_PATTERN_toynas-dunfell := "^${LAYERDIR}/"
BBFILE_PRIORITY_toynas-dunfell = "1337"

LAYERSERIES_COMPAT_toynas-dunfell = "dunfell"
```
